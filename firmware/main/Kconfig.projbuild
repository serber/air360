## firmware/main/Kconfig.projbuild
```kconfig
menu "air360 firmware"

config AIR360_BOARD_NAME
    string "Board name"
    default "esp32-s3-devkitc-1"

config AIR360_DEVICE_NAME
    string "Default device name"
    default "air360-node"

config AIR360_HTTP_PORT
    int "HTTP status server port"
    range 1 65535
    default 80

config AIR360_I2C0_SDA_GPIO
    int "I2C bus 0 SDA GPIO"
    range 0 48
    default 8

config AIR360_I2C0_SCL_GPIO
    int "I2C bus 0 SCL GPIO"
    range 0 48
    default 9

config AIR360_GPS_DEFAULT_BAUD_RATE
    int "GPS default UART baud rate"
    range 1200 115200
    default 9600

config AIR360_WIFI_RECONNECT_BASE_DELAY_MS
    int "Wi-Fi reconnect initial backoff (ms)"
    range 1000 600000
    default 10000

config AIR360_WIFI_RECONNECT_MAX_DELAY_MS
    int "Wi-Fi reconnect maximum backoff (ms)"
    range 10000 3600000
    default 300000

config AIR360_WIFI_SETUP_AP_RETRY_DELAY_MS
    int "Setup AP station retry interval (ms)"
    range 10000 3600000
    default 180000

config AIR360_WIFI_DISCONNECT_IGNORE_WINDOW_MS
    int "Wi-Fi intentional-disconnect suppression window (ms)"
    range 100 60000
    default 2000

config AIR360_WIFI_CONNECT_TIMEOUT_MS
    int "Wi-Fi station connect timeout (ms)"
    range 5000 120000
    default 15000

config AIR360_MEASUREMENT_QUEUE_DEPTH
    int "Measurement queue depth (samples)"
    range 32 2048
    default 256

config AIR360_BLE_PAYLOAD_REFRESH_INTERVAL_MS
    int "BLE payload refresh interval (ms)"
    range 1000 60000
    default 5000

config AIR360_ENABLE_LAB_AP
    bool "Enable lab AP bring-up hook"
    default y

config AIR360_LAB_AP_SSID
    string "Lab AP SSID"
    depends on AIR360_ENABLE_LAB_AP
    default "air360-phase1"

config AIR360_LAB_AP_PASSWORD
    string "Lab AP password"
    depends on AIR360_ENABLE_LAB_AP
    default "air360phase1"

config AIR360_LAB_AP_CHANNEL
    int "Lab AP channel"
    depends on AIR360_ENABLE_LAB_AP
    range 1 13
    default 1

config AIR360_LAB_AP_MAX_CONNECTIONS
    int "Lab AP max clients"
    depends on AIR360_ENABLE_LAB_AP
    range 1 8
    default 4

menu "Cellular uplink"

config AIR360_CELLULAR_DEFAULT_UART
    int "Modem UART port"
    range 1 2
    default 1

config AIR360_CELLULAR_DEFAULT_RX_GPIO
    int "Modem RX GPIO (ESP32 receives from modem TX)"
    range 0 48
    default 18

config AIR360_CELLULAR_DEFAULT_TX_GPIO
    int "Modem TX GPIO (ESP32 transmits to modem RX)"
    range 0 48
    default 17

config AIR360_CELLULAR_DEFAULT_PWRKEY_GPIO
    int "Modem PWRKEY GPIO (0xFF = not wired)"
    range 0 255
    default 12

config AIR360_CELLULAR_DEFAULT_SLEEP_GPIO
    int "Modem SLEEP/DTR GPIO (0xFF = not wired)"
    range 0 255
    default 21

config AIR360_CELLULAR_MAX_RECONNECT_ATTEMPTS
    int "PPP reconnect attempts before uplink fallback cascade"
    range 1 20
    default 4

config AIR360_CELLULAR_RECONNECT_BACKOFF_MAX_S
    int "Maximum backoff between PPP reconnect attempts (seconds)"
    range 5 300
    default 60

config AIR360_CELLULAR_WIFI_DEBUG_WINDOW_S
    int "Wi-Fi debug window duration when cellular is the uplink (seconds)"
    range 0 3600
    default 600

endmenu

endmenu
```

## firmware/sdkconfig.defaults
```kconfig
CONFIG_ESPTOOLPY_FLASHSIZE_16MB=y
CONFIG_ESPTOOLPY_FLASHSIZE="16MB"
CONFIG_PARTITION_TABLE_CUSTOM=y
CONFIG_PARTITION_TABLE_CUSTOM_FILENAME="partitions.csv"
CONFIG_COMPILER_CXX_EXCEPTIONS=n
CONFIG_COMPILER_CXX_RTTI=n
CONFIG_ESP_MAIN_TASK_STACK_SIZE=8192
CONFIG_AIR360_BOARD_NAME="esp32-s3-devkitc-1"
CONFIG_AIR360_DEVICE_NAME="air360"
CONFIG_AIR360_HTTP_PORT=80
CONFIG_AIR360_I2C0_SDA_GPIO=8
CONFIG_AIR360_I2C0_SCL_GPIO=9
CONFIG_AIR360_GPS_DEFAULT_UART_PORT=1
CONFIG_AIR360_GPS_DEFAULT_RX_GPIO=18
CONFIG_AIR360_GPS_DEFAULT_TX_GPIO=17
CONFIG_AIR360_GPS_DEFAULT_BAUD_RATE=9600
CONFIG_AIR360_WIFI_RECONNECT_BASE_DELAY_MS=10000
CONFIG_AIR360_WIFI_RECONNECT_MAX_DELAY_MS=300000
CONFIG_AIR360_WIFI_SETUP_AP_RETRY_DELAY_MS=180000
CONFIG_AIR360_WIFI_DISCONNECT_IGNORE_WINDOW_MS=2000
CONFIG_AIR360_WIFI_CONNECT_TIMEOUT_MS=15000
CONFIG_AIR360_MEASUREMENT_QUEUE_DEPTH=256
CONFIG_AIR360_BLE_PAYLOAD_REFRESH_INTERVAL_MS=5000
CONFIG_AIR360_GPIO_SENSOR_PIN_0=4
CONFIG_AIR360_GPIO_SENSOR_PIN_1=5
CONFIG_AIR360_GPIO_SENSOR_PIN_2=6
CONFIG_AIR360_ENABLE_LAB_AP=y
CONFIG_AIR360_LAB_AP_SSID="air360"
CONFIG_AIR360_LAB_AP_PASSWORD="air360password"
CONFIG_AIR360_LAB_AP_CHANNEL=1
CONFIG_AIR360_LAB_AP_MAX_CONNECTIONS=4
CONFIG_SPIRAM=y
CONFIG_SPIRAM_MODE_OCT=y
CONFIG_SPIRAM_TYPE_AUTO=y
CONFIG_SPIRAM_SPEED_80M=y
CONFIG_SPIRAM_BOOT_INIT=y
CONFIG_SPIRAM_IGNORE_NOTFOUND=y
CONFIG_SPIRAM_USE_MALLOC=y
CONFIG_SPIRAM_MEMTEST=y
CONFIG_BT_ENABLED=y
CONFIG_BT_NIMBLE_ENABLED=y
CONFIG_BT_CONTROLLER_ENABLED=y
CONFIG_BT_NIMBLE_ROLE_BROADCASTER=y
CONFIG_BT_NIMBLE_ROLE_PERIPHERAL=n
CONFIG_BT_NIMBLE_ROLE_CENTRAL=n
CONFIG_BT_NIMBLE_ROLE_OBSERVER=n
```
